## doc/linux/qemu/linux device drivers 3-source codes/lddbus/Kconfig
```kconfig
#
# LDD bus configuration
#

menuconfig LDD_BUS
    tristate "LDD bus"
    default ""
    ---help---
        test for the LDD bus.
```

## doc/linux/qemu/linux device drivers 3-source codes/lddbus/sculld/Kconfig
```kconfig
#
# sculld configuration
#

menuconfig MYSCULLD
    tristate "Sculld Devices"
    depends on LDD_BUS
    default ""
    ---help---
        test for sculld devices
```

## doc/linux/qemu/linux device drivers 3-source codes/scull/Kconfig
```kconfig
#
# scull configuration
#

menuconfig SCULL
    tristate "Scull Devices"
    default m
    ---help---
      test for char device
```

## doc/linux/qemu/linux device drivers 3-source codes/scullpipe/Kconfig
```kconfig
#
# scull configuration
#

menuconfig SCULLP
    tristate "Scull Pipe Devices"
    default m
    ---help---
      test for char device
```
